## configs/profiles/host-test.defconfig
```kconfig
# Host build for the test suite: every medium and every tool on, as the
# standalone CMake options defaulted before profiles existed.
CONFIG_KNX_STANDALONE_PLATFORM_AUTO=y
CONFIG_KNX_BUILD_TP1=y
CONFIG_KNX_BUILD_NETIP=y
CONFIG_KNX_ENABLE_TUNNELING=y
CONFIG_KNX_ENABLE_COUPLER=y
CONFIG_KNX_ENABLE_SECURITY=y
CONFIG_KNX_BUILD_VIRTUAL_BUS=y
CONFIG_KNX_BUILD_ETS_TOOLING=y
CONFIG_KNX_BUILD_TEST_HOOKS=y
CONFIG_KNX_BUILD_ZLIB=y
# Every log level compiled in, filtered at run time.
CONFIG_KNX_LOG_LEVEL=5
CONFIG_KNX_MAX_APDU_LENGTH=254
CONFIG_KNX_TP1_RX_QUEUE_FRAMES=32
CONFIG_KNX_TRANSPORT_RX_QUEUE=8
CONFIG_KNX_ADDRESS_TABLE_ENTRIES=256
CONFIG_KNX_ASSOCIATION_TABLE_ENTRIES=512
CONFIG_KNX_ADDITIONAL_INDIVIDUAL_ADDRESSES=16
CONFIG_KNX_MEMORY_REGIONS=8
CONFIG_KNX_AUTHORIZED_PARTNERS=16
CONFIG_KNX_MAX_GROUP_OBJECT_PAYLOAD_BYTES=16
CONFIG_KNX_SEND_PIPELINE_DEPTH=8
CONFIG_KNX_PENDING_ACTION_CAPACITY=0
CONFIG_KNX_CALLBACK_CAPTURE_BYTES=0
# Optional features: all on.
CONFIG_KNX_ENABLE_FUNCTION_PROPERTIES=y
CONFIG_KNX_ENABLE_PROPERTY_EXT=y
CONFIG_KNX_ENABLE_MEMORY_EXT=y
CONFIG_KNX_ENABLE_NETWORK_PARAMETER=y
CONFIG_KNX_ENABLE_GO_DIAGNOSTICS=y
CONFIG_KNX_DPT_FLOAT=y
CONFIG_KNX_DPT_TIME=y
CONFIG_KNX_DPT_STRING=y
CONFIG_KNX_DPT_COLOUR=y
CONFIG_KNX_DPT_ACCESS=y
CONFIG_KNX_ENABLE_DPT_CATALOGUE=y
CONFIG_KNX_HEAP_POLICY_FREE=y
```
